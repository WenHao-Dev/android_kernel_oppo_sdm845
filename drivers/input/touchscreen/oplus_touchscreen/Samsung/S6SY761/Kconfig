## drivers/input/touchscreen/oplus_touchscreen/Samsung/S6SY761/Kconfig
```kconfig
config TOUCHPANEL_SAMSUNG_S6SY761
	bool "TP Samsung s6sy761 IC enable or not for OPPO"
	---help---
		say Y to enable driver for Touchpanel using Samsung s6sy761
```

## drivers/platform/oplus/Kconfig
```kconfig
# OPlus configuration options

config MACH_OPLUS
	bool "OPlus device"
	depends on ARCH_QCOM
	help
	  Support for OPlus products

config MACH_OPLUS_SDM845
	bool "OPlus SDM845"
	depends on ARCH_QCOM
	select MACH_OPLUS
	help
	  Support for OPlus SDM845 devices

menu "OPlus board selection"

config MACH_OPLUS_FINDX
  bool "OPPO Find X board"
  select MACH_OPLUS_SDM845
  help
    Support for OPPO Find X (17107, 17127)

endmenu
```

## drivers/soc/oplus/Kconfig
```kconfig
config OPPO_COMMON_SOFT
	bool "config oppo common software"
	help
		define this config to get project verion from sharemem.
		Maybe this value is from CDT or dynamic identify by hardware
		id.

config OPPO_DEVICE_INFO
	bool "config oppo devinfo"
	help
		define this config to compile devinfo.c for device register

config OPLUS_FEATURE_PROJECTINFO
	tristate "config oppo common software"
	help
		define this config to get project verion from sharemem.
		Maybe this value is from CDT or dynamic identify by hardware
		id.

config OPLUS_FEATURE_RECORD_MDMRST
	bool "config record mdmrst"
	help
		define this config to count the modem restart times.
```
